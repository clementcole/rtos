## quadcopter-esp32/sdkconfig.defaults
```kconfig
CONFIG_ESP_DEFAULT_CPU_FREQ_MHZ=240
CONFIG_FREERTOS_HZ=1000
CONFIG_FREERTOS_UNICORE=n
CONFIG_FREERTOS_USE_TRACE_FACILITY=y
CONFIG_FREERTOS_USE_STATS_FORMATTING=y
CONFIG_FREERTOS_GENERATE_RUN_TIME_STATS=y

#Memory configuration
CONFIG_ESP32_REV_MIN_3=y
CONFIG_SPIRAM=y
CONFIG_SPIRAM_USE_MALLOC=y
CONFIG_SPIRAM_MALLOC_ALWAYSINTERNAL=16384

#Task priorities
CONFIG_FREERTOS_MAX_TASK_NAME_LEN=16

#Watchdog timers
CONFIG_ESP_TASK_WDT=y
CONFIG_ESP_TASK_WDT_TIMEOUT=5
CONFIG_ESP_TASK_WDT_CHECK_IDLE_TASK_CPUD=n

#logging
CONFIG_LOG_DEFAULT_LEVEL_INFO=y
CONFIG_LOG_TIMESTAMP_SOURCE_RTOS=y

#Drivers
CONFIG_I2CDEV_TIMEOUT=1000
CONFIG_MPU6050_ENABLE=y
CONFIG_BMP280_ENABLE=y
CONFIG_PWM_DRIVER_ENABLE=y
CONFIG_RC_RECEIVER_ENABLE=y

#Flight Control
CONFIG_CONTROL_LOOP_FREQ=200
CONFIG_SENSOR_READ_FREQ=400
CONFIG_PID_UPDATE_FREQ=200
CONFIG_TELEMETRY_FREQ=50

#Wifi for telemetry
CONFIG_ESP_WIFI_SSID="Quadcopter"
CONFIG_ESP_WIFI_PASSWORD="flight123"
CONFIG_ESP_MAX_STA_CONN=1
```
